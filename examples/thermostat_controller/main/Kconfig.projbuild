## examples/thermostat_controller/main/Kconfig.projbuild
```kconfig
menu "Example Configuration"

    config THERMOSTAT_CONTROLLER_SUBSCRIBE_MIN_INTERVAL
        int "Minimum subscription interval (s)"
        default 1
        range 0 60
        help
            Minimum interval, in seconds, requested when subscribing to the bound thermostat's
            ThermostatRunningState attribute.

    config THERMOSTAT_CONTROLLER_SUBSCRIBE_MAX_INTERVAL
        int "Maximum subscription interval (s)"
        default 10
        range 1 3600
        help
            Maximum interval, in seconds, requested when subscribing to the bound thermostat's
            ThermostatRunningState attribute. This bounds how quickly a heat demand change is
            reported when no attribute report is otherwise received (keep-alive).

    config THERMOSTAT_CONTROLLER_HEATING_HYSTERESIS_CENTIDEGREES
        int "LocalTemperature/OccupiedHeatingSetpoint fallback hysteresis (0.01 degC)"
        default 50
        range 0 500
        help
            Some thermostats do not report ThermostatRunningState, or report it without the
            Heat bit changing. As a fallback, heat demand is also inferred by comparing
            LocalTemperature to OccupiedHeatingSetpoint: demand turns on once LocalTemperature
            drops to (setpoint - hysteresis) or below, and turns off once LocalTemperature
            reaches the setpoint. This avoids rapid toggling around the setpoint. Value is in
            hundredths of a degree Celsius, matching the Matter attribute encoding (default 50
            = 0.5 degC).

endmenu
```

## notes/wifipaf_mtu_spike/publisher/main/Kconfig.projbuild
```kconfig
menu "Example Configuration"

    config ESP_WIFI_USD_PUB_SVC_NAME
        string "USD publish service name"
        default "ESP-PAF-SPIKE"

    config ESP_WIFI_USD_PUB_TTL
        int "Time to live (in seconds)"
        range 0 1000
        default 100
        help
            Time to live of the Publish instance, in seconds.

    config PAF_SPIKE_FRAG_SIZE
        int "Fragment size (bytes)"
        range 16 2048
        default 350
        help
            Payload size of each follow-up fragment, in bytes. Default matches
            connectedhomeip's CHIP_PAF_DEFAULT_MTU (WiFiPAFConfig.h).

    config PAF_SPIKE_FRAG_COUNT
        int "Fragment count"
        range 1 64
        default 6
        help
            Number of back-to-back follow-up fragments sent once triggered by
            the subscriber. 6 x 350 B ~= 2.1 KB, roughly a real PASE message.

endmenu
```

## notes/wifipaf_mtu_spike/subscriber/main/Kconfig.projbuild
```kconfig
menu "Example Configuration"

    config ESP_WIFI_USD_SUB_SVC_NAME
        string "USD subscribe service name"
        default "ESP-PAF-SPIKE"

    config ESP_WIFI_USD_SUB_TTL
        int "Time to live (in seconds)"
        range 0 1000
        default 100
        help
            Time to live of the Subscribe instance, in seconds.

    config ESP_WIFI_USD_DEFAULT_CHAN
        int "Default Subscribe channel"
        range 1 13
        default 6
        help
            Default channel of subscriber

    config PAF_SPIKE_FRAG_COUNT
        int "Expected fragment count"
        range 1 64
        default 6
        help
            How many fragments to wait for before printing the summary. Must
            match the publisher's PAF_SPIKE_FRAG_COUNT.

    config PAF_SPIKE_FRAG_TIMEOUT_MS
        int "Per-burst timeout (ms)"
        range 100 60000
        default 5000
        help
            How long to wait, after the trigger is sent, for the whole burst
            to arrive before giving up and printing a partial summary.

endmenu
```
